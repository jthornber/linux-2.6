## drivers/md/persistent-data/Kconfig
```kconfig
config DM_PERSISTENT_DATA
       tristate "Persistent data library"
       depends on BLK_DEV_DM
       select LIBCRC32C
       select DM_BUFIO
       ---help---
	 Library providing immutable on-disk data structure support
	 for device-mapper targets such as the thin provisioning and
	 caching targets.

config DM_DEBUG_BLOCK_LOCKING
       boolean "Use locking to restrict concurrent access to blocks"
       depends on DM_PERSISTENT_DATA
       ---help---
         Enable this to help debug code that uses DM_PERSISTENT_DATA.

         If unsure, say N.

config DM_DEBUG_BLOCK_STACK_TRACING
	boolean "Keep stack trace of thin provisioning block lock holders"
	depends on DM_DEBUG_BLOCK_LOCKING && STACKTRACE_SUPPORT
	select STACKTRACE
	---help---
	  Enable this for messages that may help debug problems with the
	  block manager locking used by thin provisioning.

	  If unsure, say N.
```
